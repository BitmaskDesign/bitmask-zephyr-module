/*
 * Copyright (c) 2020 Nordic Semiconductor ASA
 *
 * SPDX-License-Identifier: Apache-2.0
 */

/dts-v1/;
#include <arm/nordic/nrf5340_cpuapp_ns_qkaa.dtsi>
#include "nrf5340_cpuapp_common.dtsi"
#include <../boards/common/usb/cdc_acm_serial.dtsi>

/ {
	model = "Bitmask BMD100 NRF5340 Application";
	compatible = "bitmask,bmd100-nrf5340-cpuapp";

	chosen {
		zephyr,sram = &sram0_ns_app;
		zephyr,flash = &flash0;
		zephyr,code-partition = &slot0_ns_partition;
	};
};

/* Include default memory partition configuration file */
#include <nordic/nrf5340_cpuapp_ns_partition.dtsi>
